## buildroot-external/Config.in
```kconfig
config BR2_SNAPOS_OVERLAY
	bool "SnapOS overlay"
	help
	  Use device tree overlay instead of onboard sound

if BR2_SNAPOS_OVERLAY

config BR2_SNAPOS_OVERLAY_NAME
        string "SnapOS overlay name"
        default "hifiberry-dacplus"
	help
	  The name of the device tree overlay file to use

endif

config BR2_SNAPOS_WIFI
	bool "SnapOS wireless"
	help
	  Configure SnapOS wireless network settings

if BR2_SNAPOS_WIFI

config BR2_SNAPOS_WIFI_SSID
	string "SnapOS WLAN SSID"
        default "snapcast"
	help
	  The SSID to connect to

config BR2_SNAPOS_WIFI_KEY
	string "SnapOS WLAN key"
        default ""
	help
	  The pre-shared key to use to connect to wireless network

endif

source "$BR2_EXTERNAL_SNAPOS_PATH/package/snapcast/Config.in"
source "$BR2_EXTERNAL_SNAPOS_PATH/package/snap-mpd/Config.in"
source "$BR2_EXTERNAL_SNAPOS_PATH/package/snapcontrol/Config.in"
```

## buildroot-external/configs/snapos_rpi0w_defconfig
```kconfig
BR2_arm=y
BR2_arm1176jzf_s=y
BR2_ARM_EABIHF=y
BR2_CCACHE=y
BR2_CCACHE_DIR="$(HOME)/.ccache"
BR2_TOOLCHAIN_BUILDROOT_UCLIBC=y
BR2_TOOLCHAIN_BUILDROOT_WCHAR=y
BR2_PACKAGE_HOST_LINUX_HEADERS_CUSTOM_5_10=y
BR2_TOOLCHAIN_BUILDROOT_CXX=y
BR2_TARGET_GENERIC_HOSTNAME="snapcast"
BR2_TARGET_GENERIC_ISSUE="Welcome to Snapcast"
BR2_ROOTFS_DEVICE_TABLE="$(BR2_EXTERNAL_SNAPOS_PATH)/board/raspberrypi/raspberrypi0w/device_table.txt"
BR2_ROOTFS_DEVICE_CREATION_STATIC=y
BR2_ROOTFS_STATIC_DEVICE_TABLE="$(BR2_EXTERNAL_SNAPOS_PATH)/board/raspberrypi/raspberrypi0w/device_table_dev.txt"
#BR2_ROOTFS_DEVICE_CREATION_DYNAMIC_DEVTMPFS=y
#BR2_ROOTFS_DEVICE_CREATION_DYNAMIC_MDEV=y
BR2_TARGET_GENERIC_ROOT_PASSWD="snapcast"
BR2_ROOTFS_OVERLAY="$(BR2_EXTERNAL_SNAPOS_PATH)/rootfs $(BR2_EXTERNAL_SNAPOS_PATH)/settings"
BR2_ROOTFS_POST_BUILD_SCRIPT="$(BR2_EXTERNAL_SNAPOS_PATH)/board/raspberrypi/common/post-build.sh board/raspberrypi/post-build.sh"
BR2_ROOTFS_POST_IMAGE_SCRIPT="$(BR2_EXTERNAL_SNAPOS_PATH)/board/raspberrypi/common/post-image.sh $(BR2_EXTERNAL_SNAPOS_PATH)/board/raspberrypi/raspberrypi0w/post-image.sh"
BR2_ROOTFS_POST_SCRIPT_ARGS="--add-wlan0 --speedup-boot --raise-volume --mount-boot --gpu_mem_256=16 --add-audio"
BR2_LINUX_KERNEL=y
BR2_LINUX_KERNEL_CUSTOM_TARBALL=y
BR2_LINUX_KERNEL_CUSTOM_TARBALL_LOCATION="$(call github,raspberrypi,linux,6af8ae321a801a4e20183454c65eb0d23069d8ac)/linux-6af8ae321a801a4e20183454c65eb0d23069d8ac.tar.gz"
#BR2_LINUX_KERNEL_USE_DEFCONFIG=y
#BR2_LINUX_KERNEL_DEFCONFIG="bcmrpi"
BR2_LINUX_KERNEL_USE_CUSTOM_CONFIG=y
BR2_LINUX_KERNEL_CUSTOM_CONFIG_FILE="$(BR2_EXTERNAL_SNAPOS_PATH)/board/raspberrypi/raspberrypi0w/linux.config"
BR2_LINUX_KERNEL_CUSTOM_LOGO_PATH="$(BR2_EXTERNAL_SNAPOS_PATH)/snapcast.png"
BR2_LINUX_KERNEL_LZ4=y
BR2_LINUX_KERNEL_DTS_SUPPORT=y
BR2_LINUX_KERNEL_INTREE_DTS_NAME="bcm2708-rpi-zero-w"
BR2_LINUX_KERNEL_NEEDS_HOST_OPENSSL=y
BR2_PACKAGE_BUSYBOX_CONFIG="$(BR2_EXTERNAL_SNAPOS_PATH)/board/raspberrypi/raspberrypi0w/busybox.config"
BR2_PACKAGE_ALSA_UTILS=y
BR2_PACKAGE_ALSA_UTILS_AMIXER=y
BR2_PACKAGE_ALSA_UTILS_APLAY=y
BR2_PACKAGE_ALSA_UTILS_SPEAKER_TEST=y
BR2_PACKAGE_RPI_FIRMWARE=y
BR2_PACKAGE_RPI_FIRMWARE_INSTALL_VCDBG=n
BR2_PACKAGE_RPI_BT_FIRMWARE=y
BR2_PACKAGE_RPI_WIFI_FIRMWARE=y
BR2_PACKAGE_CRDA=y
BR2_PACKAGE_DHCPCD=n
BR2_PACKAGE_DROPBEAR=y
BR2_PACKAGE_DROPBEAR_SMALL=n
BR2_PACKAGE_IW=y
BR2_PACKAGE_WPA_SUPPLICANT=y
BR2_TARGET_ROOTFS_EXT2=y
BR2_TARGET_ROOTFS_EXT2_4=y
BR2_TARGET_ROOTFS_EXT2_SIZE="256M"
# BR2_TARGET_ROOTFS_TAR is not set
BR2_PACKAGE_HOST_DOSFSTOOLS=y
BR2_PACKAGE_HOST_GENIMAGE=y
BR2_PACKAGE_HOST_MTOOLS=y
BR2_PACKAGE_SNAPCAST=y
```

## buildroot-external/package/snapcontrol/Config.in
```kconfig
config BR2_PACKAGE_SNAPCONTROL
	bool "Snapcontrol"
	depends on BR2_PACKAGE_SNAPCAST
	select BR2_PACKAGE_PYTHON3
	help
	  Python3 controller for Snapcast
```
